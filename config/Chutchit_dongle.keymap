/*
 * Chutchit Dongle Keymap
 * Minimal 1-key stub — the dongle does not process key events.
 * It receives pre-formed HID reports over 2.4G and forwards them to USB.
 */

#include <behaviors.dtsi>
#include <dt-bindings/zmk/keys.h>

/ {
    keymap {
        compatible = "zmk,keymap";

        default_layer {
            bindings = <&trans>;
        };
    };
};
